/*
* HexDisplay.asm
*
*  Created: 12/13/2017 1:48:29 PM
*   Author: C. D'Arcy
*/
.cseg
.org 0x0000
  rjmp  reset
;segment table format: ;gfab_cde.
.org 0x100
segmentStart:
.db    0b1111_1100, 0b00110000,0b11011010,0b01111010, 0b00110110,0b01101110,0b11101110,0b00111000,0b11111110,0b00111110,0b10111110,0b111100110,0b11001100,0b11110010,0b11001110,0b10001111
 //.db 0b1111_1100, 0b0001_1000, 0b1011_0110, 0b1011_1100 ;0-3 The underscores are permissible and optional
 //.db 0b1101_1000, 0b1110_1100, 0b1110_1110, 0b0011_1000 ;4-7           They do make their interpretation more readable
  //.db 0b1111_1110, 0b1111_1000, 0b1111_1010, 0b1100_1110 ;8-B
 //.db 0b0110_0110, 0b1001_1110, 0b1110_0110, 0b1110_0011 ;C-F
segmentEnd:
reset:
 ldi   r16, low(RAMEND)                        ;ALL assembly code should start by
 out   spl,r16                                 ; setting the Stack Pointer to
  ldi   r16, high(RAMEND)                       ; the end of SRAM to support
 out   sph,r16                                 ; function calls, etc.
 ldi   xl,low(segmentStart<<1) ;position X and Y pointers to the
 ldi   xh,high(segmentStart<<1)        ; start and end addresses of
  ldi   yl,low(segmentEnd<<1)   ; our data table, respectively
 ldi   yh,high(segmentEnd<<1)  ;
 movw  z,x                                             ;start Z pointer off at the start address of the table.

 rcall initPorts     ;set I/O Direction

more:
 lpm   r17,z+         ;Load the first instance of the test data from Program Memory
 out   PORTD,r17     ;display the digit
 rcall myDelay        ;admire...
 cp    zl,yl          ;have we reached the end of the table?  (Z==Y?)
 brne  more           ; if not, repeat with next byte...
 movw  z,x            ; if so, reset Z pointer to start address of table and...
 rjmp  more           ;...repeat


initPorts:
 ser  r16
 out  DDRD,r16         ;declare PORTD for output
 ret
myDelay:
; Generated by delay loop calculator
; at http://www.bretmulvey.com/avrdelay.html
;
; Delay 8 000 000 cycles
; 500ms at 16 MHz

   ldi  r18, 41
   ldi  r19, 150
   ldi  r20, 128
L1: dec  r20
   brne L1
   dec  r19
   brne L1
   dec  r18
   brne L1

ret