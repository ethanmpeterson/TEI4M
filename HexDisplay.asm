;
; Hex Decimal Display.asm
;
; Created: 2017-12-15 8:40:32 AM
; Author : Ethan Peterson (Template from Mr. D'Arcy)
;
.cseg                                          ;load into Program Memory
.org   0x0000                          ;start of Interrupt Vector (Jump) Table
        rjmp    reset                           ;address  of start of code
startTable:    ; 	0		1			2			3			4			5			6			7		8			9			A			B		C			D			E			F
        .DB    0b1111100,0b00110000,0b11011010,0b01111010, 0b00110110,0b01101110,0b11101110,0b00111000,0b11111110,0b00111110,0b10111110,0b111100110,0b11001100,0b11110010,0b11001110,0b10001111  ;byte values for 7 segement animation
        ;.DB    "Hello, World!"         ;for some future exercise :)
endTable:
.org    0x100                                   ;abitrary address for start of code
 reset:
        ldi             r16, low(RAMEND)        ;ALL assembly code should start by
        out             spl,r16                 ; setting the Stack Pointer to
        ldi             r16, high(RAMEND)       ; the end of SRAM to support
        out             sph,r16                 ; function calls, etc.

        rcall   initPorts               ;set I/O Direction

        ldi             xl,low(startTable<<1)   ;position X and Y pointers to the
        ldi             xh,high(startTable<<1)  ; start and end addresses of
        ldi             yl,low(endTable<<1)     ; our data table, respectively
        ldi             yh,high(endTable<<1)    ;
        movw    z,x                                             ;start Z pointer off at the start address of the table.

more:
        lpm             r19,z+                          ;Load the first instance of the test data from Program Memory
        rcall   showDigit                                ;show digit from the table on the seven segment display
        rcall   myDelay                         ;admire...
        cp              zl,yl                           ;have we reached the end of the table?  (Z==Y?)
        brne    more                                            ; if not, repeat with next byte...
        movw    z,x
		rjmp more                                            ; if so, reset Z pointer to start address of table and repeat  

initPorts: // set all of portD to output as all its pins are needed to operate the display
        ldi  r16, 0xFF
        out  DDRD, r16                                
        ret

showDigit:
	mov r18, r19 // copy data into r18
	out PORTD, r18 // show digit on PORTD / Display
	ret // return back to more label where showDigit was called
	

myDelay:
; Generated by delay loop calculator
; at http://www.bretmulvey.com/avrdelay.html
; Delay 8 000 000 cycles
; 500ms at 16 MHz

   ldi  r20, 41
   ldi  r21, 150
   ldi  r22, 128
L1: dec  r22
   brne L1
   dec  r21
   brne L1
   dec  r20
   brne L1
   nop
ret

